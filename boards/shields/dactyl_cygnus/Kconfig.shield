## boards/shields/dactyl_cygnus/Kconfig.shield
```kconfig
config SHIELD_DACTYL_CYGNUS_LEFT
    def_bool $(shields_list_contains,dactyl_cygnus_left)
  
config SHIELD_DACTYL_CYGNUS_RIGHT
    def_bool $(shields_list_contains,dactyl_cygnus_right)
  
```
